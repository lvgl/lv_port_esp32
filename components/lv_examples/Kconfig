## components/lvgl_ili9341/Kconfig
```kconfig
menu "LittlevGL (LVGL)"

    choice
        prompt "Select predefined display configuration"
        default LVGL_PREDEFINED_DISPLAY_NONE
        help
            Select predefined display configuration

        config LVGL_PREDEFINED_DISPLAY_NONE
            bool "None"
        config LVGL_PREDEFINED_DISPLAY_WROVER4
            bool "ESP-Wrover-KIT v4.1"
        config LVGL_PREDEFINED_DISPLAY_M5STACK
            bool "M5Stack"
		config LVGL_PREDEFINED_DISPLAY_ERTFT0356
			bool "ER-TFT035-6"
    endchoice

    choice
        prompt "Select predefined board pinouts" if LVGL_PREDEFINED_DISPLAY_NONE || LVGL_PREDEFINED_DISPLAY_ERTFT0356
        default LVGL_PREDEFINED_PINS_NONE
        help
            Select predefined board pin out configuration.

        config LVGL_PREDEFINED_PINS_NONE
            bool "None"
        config LVGL_PREDEFINED_PINS_38V4
            bool "ESP32 DevKit v4 (38 GPIOS)"
        config LVGL_PREDEFINED_PINS_30
            bool "ESP32 Devkit v1 - 30 pins"
        config LVGL_PREDEFINED_PINS_38V1
            bool "Dev Board with 38 pins"
    endchoice

    config LVGL_TFT_DISPLAY_CONTROLLER
	int
	default 0 if LVGL_TFT_DISPLAY_CONTROLLER_ILI9341
	default 1 if LVGL_TFT_DISPLAY_CONTROLLER_ILI9488 || LVGL_PREDEFINED_DISPLAY_ERTFT0356
	default 2 if LVGL_TFT_DISPLAY_CONTROLLER_HX8357D

	choice
	    prompt "Select a display controller model." if LVGL_PREDEFINED_DISPLAY_NONE
	    default LVGL_TFT_DISPLAY_CONTROLLER_ILI9341 if LVGL_PREDEFINED_DISPLAY_WROVER4
	    default LVGL_TFT_DISPLAY_CONTROLLER_ILI9341 if LVGL_PREDEFINED_DISPLAY_M5STACK
		default LVGL_TFT_DISPLAY_CONTROLLER_ILI9488 if LVGL_PREDEFINED_DISPLAY_ERTFT0356
	    default LVGL_TFT_DISPLAY_CONTROLLER_ILI9341
	    help
			Select the controller for your display.

	    config LVGL_TFT_DISPLAY_CONTROLLER_ILI9341
		bool "ILI9341"
	    config LVGL_TFT_DISPLAY_CONTROLLER_ILI9488
		bool "ILI9488"
		config LVGL_TFT_DISPLAY_CONTROLLER_HX8357D
		bool "ST8357D"
	endchoice
        
    choice
    	prompt "TFT SPI Bus."
    	default LVGL_TFT_DISPLAY_SPI_HSPI
    	help
    		Select the SPI Bus the TFT Display is attached to.
    	
    	config LVGL_TFT_DISPLAY_SPI_HSPI
    	bool "HSPI"
    	config LVGL_TFT_DISPLAY_SPI_VSPI
    	bool "VSPI"
	endchoice
	
    config LVGL_DISPLAY_WIDTH
        int
        prompt "TFT display width in pixels." if LVGL_PREDEFINED_DISPLAY_NONE
        default 240 if LVGL_PREDEFINED_DISPLAY_M5STACK
		default 480 if LVGL_PREDEFINED_DISPLAY_ERTFT0356
        default 320

    config LVGL_DISPLAY_HEIGHT
        int
        prompt "TFT display height in pixels." if LVGL_PREDEFINED_DISPLAY_NONE
        default 320 if LVGL_PREDEFINED_DISPLAY_M5STACK || LVGL_PREDEFINED_DISPLAY_ERTFT0356
        default 240
	
    config LVGL_TOUCH_CONTROLLER
		int
		default 0 if LVGL_TOUCH_CONTROLLER_NONE
		default 1 if LVGL_TOUCH_CONTROLLER_XPT2046
		default 2 if LVGL_TOUCH_CONTROLLER_FT6X06
		default 3 if LVGL_TOUCH_CONTROLLER_STMPE610

	choice
	    prompt "Select a touch panel controller model." if LVGL_PREDEFINED_DISPLAY_NONE || LVGL_PREDEFINED_DISPLAY_ERTFT0356
		default LVGL_TOUCH_CONTROLLER_NONE
	    help
		Select the controller for your touch panel.

	    config LVGL_TOUCH_CONTROLLER_NONE
		bool "None"
	    config LVGL_TOUCH_CONTROLLER_XPT2046
		bool "XPT2046"
	    config LVGL_TOUCH_CONTROLLER_FT6X06
        bool "FT6X06"
        config LVGL_TOUCH_CONTROLLER_STMPE610
        bool "STMPE610"
        
	endchoice

    config LVGL_INVERT_DISPLAY
        bool
        prompt "Invert display." if LVGL_PREDEFINED_DISPLAY_NONE
        default y if LVGL_PREDEFINED_DISPLAY_M5STACK
        default n
        help
        If text is backwards on your display, try enabling this.

    config LVGL_ENABLE_BACKLIGHT_CONTROL
        bool
        prompt "Enable control of the display backlight by using an GPIO." if LVGL_PREDEFINED_DISPLAY_NONE
        default y if LVGL_PREDEFINED_DISPLAY_M5STACK || LVGL_PREDEFINED_DISPLAY_WROVER4 || LVGL_PREDEFINED_DISPLAY_ERTFT0356
        default n
        help
        Enable controlling the display backlight using an GPIO
        
    config LVGL_BACKLIGHT_ACTIVE_LVL
        bool
        prompt "Is backlight turn on with a HIGH (1) logic level?" if LVGL_ENABLE_BACKLIGHT_CONTROL && LVGL_PREDEFINED_DISPLAY_NONE
        default y if LVGL_PREDEFINED_DISPLAY_M5STACK || LVGL_PREDEFINED_DISPLAY_ERTFT0356
        default n if LVGL_PREDEFINED_DISPLAY_WROVER4
        default n
        help
        Some backlights are turned on with a high signal, others held low.
        If enabled, a value of 1 will be sent to the display to enable the backlight,
        otherwise a 0 will be expected to enable it.

    config LVGL_PREDEFINED_PINS
       bool
       default n if LVGL_PREDEFINED_PINS_NONE
       default y

    menu "Display Pin Assignments"
      visible if !LVGL_PREDEFINED_PINS

        config LVGL_DISP_SPI_MOSI
            int
            prompt "GPIO for MOSI (Master Out Slave In)"
	    range 0 39	
            default 23 if LVGL_PREDEFINED_DISPLAY_WROVER4
            default 23 if LVGL_PREDEFINED_DISPLAY_M5STACK
            default 13

            help
            Configure the display MOSI pin here.

        config LVGL_DISP_SPI_CLK
            int "GPIO for CLK (SCK / Serial Clock)"
	    range 0 39	
            default 18 if LVGL_PREDEFINED_DISPLAY_M5STACK
            default 19 if LVGL_PREDEFINED_DISPLAY_WROVER4
            default 14
            help
            Configure the display CLK pin here.

        config LVGL_DISP_SPI_CS
            int "GPIO for CS (Slave Select)"
	    range 0 39	
            default 5 if LVGL_PREDEFINED_PINS_38V1
            default 14 if LVGL_PREDEFINED_DISPLAY_M5STACK
            default 22 if LVGL_PREDEFINED_DISPLAY_WROVER4
            default 15
            help
            Configure the display CS pin here.

        config LVGL_DISP_PIN_DC
            int "GPIO for DC (Data \ Command)"
	    range 0 39	
            default 19 if LVGL_PREDEFINED_PINS_38V1
            default 17 if LVGL_PREDEFINED_PINS_38V4
            default 27 if LVGL_PREDEFINED_DISPLAY_M5STACK
            default 21 if LVGL_PREDEFINED_DISPLAY_WROVER4
            default 2
            help
            Configure the DC pin here.

        config LVGL_DISP_PIN_RST
            int "GPIO for Reset"
	    range 0 39	
            default 18 if LVGL_PREDEFINED_PINS_38V1
            default 25 if LVGL_PREDEFINED_PINS_38V4
            default 33 if LVGL_PREDEFINED_DISPLAY_M5STACK
            default 18 if LVGL_PREDEFINED_DISPLAY_WROVER4
            default 4
            help
            Configure the reset pin here.

        config LVGL_DISP_PIN_BCKL
            int "GPIO for Backlight Control"
	    range 0 39	
            default 23 if LVGL_PREDEFINED_PINS_38V1
            default 26 if LVGL_PREDEFINED_PINS_38V4
            default 32 if LVGL_PREDEFINED_DISPLAY_M5STACK
            default 5 if LVGL_PREDEFINED_DISPLAY_WROVER4
            default 21
            help
            Configure the DC pin here.
    endmenu

    menu "Touchpanel (XPT2046) Pin Assignments"
      visible if !LVGL_PREDEFINED_PINS && LVGL_TOUCH_CONTROLLER = 1

        config LVGL_TOUCH_SPI_MISO
            int
            prompt "GPIO for MISO (Master In Slave Out)"
	    range 0 39	
            default 35 if LVGL_PREDEFINED_PINS_38V1
            default 19

            help
            Configure the touchpanel MISO pin here.

        config LVGL_TOUCH_SPI_MOSI
            int
            prompt "GPIO for MOSI (Master Out Slave In)"
	    range 0 39	
            default 32 if LVGL_PREDEFINED_PINS_38V1
            default 23

            help
            Configure the touchpanel MOSI pin here.

        config LVGL_TOUCH_SPI_CLK
            int "GPIO for CLK (SCK / Serial Clock)"
	    range 0 39	
            default 26 if LVGL_PREDEFINED_PINS_38V1
            default 18
            help
            Configure the touchpanel CLK pin here.

        config LVGL_TOUCH_SPI_CS
            int "GPIO for CS (Slave Select)"
	    range 0 39	
            default 33 if LVGL_PREDEFINED_PINS_38V1
            default 5
            help
            Configure the touchpanel CS pin here.

        config LVGL_TOUCH_PIN_IRQ
            int "GPIO for IRQ (Interrupt Request)"
	    range 0 39	
            default 27 if LVGL_PREDEFINED_PINS_38V4
            default 25
            help
            Configure the touchpanel CS pin here.
    endmenu

    menu "Touchpanel (FT6X06) Pin Assignments"
      visible if LVGL_TOUCH_CONTROLLER = 2
        config LVGL_TOUCH_I2C_SDA
            int
            prompt "GPIO for SDA (I2C)"
        range 0 39
            default 21
            help
            Configure the I2C touchpanel SDA pin here.

        config LVGL_TOUCH_I2C_SCL
            int "GPIO for clock signal SCL (I2C)"
        range 0 39
            default 22
            help
            Configure the I2C touchpanel SCL pin here.
    endmenu
    
    menu "Touchpanel (STMPE610) Pin Assignments"
      visible if !LVGL_PREDEFINED_PINS && LVGL_TOUCH_CONTROLLER = 3

        config LVGL_TOUCH_SPI_MISO
            int
            prompt "GPIO for MISO (Master In Slave Out)"
	    range 0 39	
            default 35 if LVGL_PREDEFINED_PINS_38V1
            default 19

            help
            Configure the touchpanel MISO pin here.

        config LVGL_TOUCH_SPI_MOSI
            int
            prompt "GPIO for MOSI (Master Out Slave In)"
	    range 0 39	
            default 32 if LVGL_PREDEFINED_PINS_38V1
            default 23

            help
            Configure the touchpanel MOSI pin here.

        config LVGL_TOUCH_SPI_CLK
            int "GPIO for CLK (SCK / Serial Clock)"
	    range 0 39	
            default 26 if LVGL_PREDEFINED_PINS_38V1
            default 18
            help
            Configure the touchpanel CLK pin here.

        config LVGL_TOUCH_SPI_CS
            int "GPIO for CS (Slave Select)"
	    range 0 39	
            default 33 if LVGL_PREDEFINED_PINS_38V1
            default 5
            help
            Configure the touchpanel CS pin here.
    endmenu
    
    menu "Touchpanel SPI Bus"
      visible if LVGL_TOUCH_CONTROLLER = 1 || LVGL_TOUCH_CONTROLLER = 3
      	choice
    		prompt "Touch Controller SPI Bus."
    		default LVGL_TOUCH_CONTROLLER_SPI_VSPI
    		help
    			Select the SPI Bus the TFT Display is attached to.
    	
    		config LVGL_TOUCH_CONTROLLER_SPI_HSPI
    		bool "HSPI"
    		config LVGL_TOUCH_CONTROLLER_SPI_VSPI
    		bool "VSPI"
		endchoice
    endmenu

    menu "Touchpanel Configuration (XPT2046)"
      visible if LVGL_TOUCH_CONTROLLER = 1

        config LVGL_TOUCH_X_MIN
            int
            prompt "Minimum X coordinate value."
            default 0 if LVGL_PREDEFINED_PINS_38V4
            default 1000

        config LVGL_TOUCH_Y_MIN
            int
            prompt "Minimum Y coordinate value."
            default 0 if LVGL_PREDEFINED_PINS_38V4
            default 1000

        config LVGL_TOUCH_X_MAX
            int
            prompt "Maximum X coordinate value."
            default 4095 if LVGL_PREDEFINED_PINS_38V4
            default 3200

        config LVGL_TOUCH_Y_MAX
            int
            prompt "Maximum Y coordinate value."
            default 4095 if LVGL_PREDEFINED_PINS_38V4
            default 2000

        config LVGL_TOUCH_INVERT_X
            bool
            prompt "Invert X coordinate value."
            default y

        config LVGL_TOUCH_INVERT_Y
            bool
            prompt "Invert Y coordinate value."
            default y
    endmenu
	
	menu "Touchpanel Configuration (FT6X06)"
      visible if LVGL_TOUCH_CONTROLLER = 2
	  
		config LVGL_FT6X36_SWAPXY
			bool
			prompt "Swap X with Y coordinate."
			default y

        config LVGL_FT6X36_INVERT_X
            bool
            prompt "Invert X coordinate value."
            default n

        config LVGL_FT6X36_INVERT_Y
            bool
            prompt "Invert Y coordinate value."
            default y

    endmenu

    menu "Touchpanel Configuration (STMPE610)"
      visible if LVGL_TOUCH_CONTROLLER = 3

        config LVGL_TOUCH_X_MIN
            int
            prompt "Minimum X coordinate value."
            default 400

        config LVGL_TOUCH_Y_MIN
            int
            prompt "Minimum Y coordinate value."
            default 300

        config LVGL_TOUCH_X_MAX
            int
            prompt "Maximum X coordinate value."
            default 3700

        config LVGL_TOUCH_Y_MAX
            int
            prompt "Maximum Y coordinate value."
            default 3700
        
        config LVGL_TOUCH_XY_SWAP
        	bool
        	prompt "Swap XY."
        	default n

        config LVGL_TOUCH_INVERT_X
            bool
            prompt "Invert X coordinate value."
            default y

        config LVGL_TOUCH_INVERT_Y
            bool
            prompt "Invert Y coordinate value."
            default y
    endmenu
endmenu
```
