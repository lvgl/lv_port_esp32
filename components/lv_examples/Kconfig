## components/lv_examples/Kconfig
```kconfig
menu "LVGL examples configuration"

    choice LV_APP_TO_RUN
        prompt "Choose a demo or example to run."

        config LV_EXAMPLES_DEMO_WIDGETS
        bool "DEMO WIDGETS: Show some widgets in action."

        config LV_EXAMPLES_DEMO_WIDGETS_SLIDESHOW
        bool "Automatically switch tabs on the demo widgets demo."
        depends on LV_EXAMPLES_DEMO_WIDGETS
    
        config LV_EXAMPLES_DEMO_STRESS
        bool "DEMO STRESS: A stress test for LVGL."
        
        config LV_EXAMPLES_DEMO_BENCHMARK
        bool "DEMO BENCHMARK: Tests the performance in various cases."
        
        config LV_EXAMPLES_DEMO_KEYPAD_ENCODER
        bool "DEMO KEYPAD ENCODER: Showcase button, drop-down lists, rollers, sliders, switches and text inputs without touch control."
        
        config LV_EXAMPLES_DEMO_PRINTER
        bool "DEMO PRINTER: A printer example created with LVGL."
        help
            Requirements:
            - 800x480 display.
            - ~1.6MB of Flash memory.
            - Montserrat 14 font.
            - Montserrat 22 font.
            - Montserrat 28 font.
            - Montserrat 32 font.

    endchoice

endmenu
```
